## config/west.yml
```yaml
manifest:
  remotes:
    - name: zmkfirmware
      url-base: https://github.com/zmkfirmware
    - name: ergohaven
      url-base: https://github.com/ergohaven
  projects:
    - name: zmk
      remote: zmkfirmware
      revision: main
      import: app/west.yml
    - name: ergohaven-zmk
      remote: ergohaven
      revision: main
  self:
    path: config
```
